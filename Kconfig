## Kconfig
```kconfig
# SPDX-License-Identifier: MIT
#
# Code shared by the status screens of this config. A shield selects the parts
# its screen needs. Only the inversion is meant to be set by hand.

config SHARED_DISPLAY_INVERTED
    bool "Invert the colours of the shared status screens"

config SHARED_DRAW
    bool
    select LV_USE_CANVAS
    select LV_USE_IMAGE
    select LV_FONT_UNSCII_8
    select LV_FONT_MONTSERRAT_12

config SHARED_KEYS_CORE
    bool

config SHARED_STATUS_STATE
    bool

config SHARED_CLOCK
    bool

config SHARED_BEHAVIOR_CLOCK
    bool
    default y
    depends on DT_HAS_ZMK_BEHAVIOR_OLED_CLOCK_ENABLED && SHARED_CLOCK

config SHARED_KEY_RGB
    bool "Light a pressed key's LED in a random colour and fade it out"
    default y
    depends on DT_HAS_SKURATOVICH_KEY_RGB_ENABLED && ZMK_RGB_UNDERGLOW
    help
      Needs a skuratovich,key-rgb node in the devicetree (normally in the keymap)
      that maps key positions to LEDs of the chosen zmk,underglow strip. The
      effect runs while ZMK's underglow is off; with the underglow on, ZMK's
      effect owns the whole strip.

if SHARED_KEY_RGB

config SHARED_KEY_RGB_FADE_MS
    int "Milliseconds a pressed key's LED takes to fade out"
    default 1000
    range 50 10000

config SHARED_KEY_RGB_TICK_MS
    int "Milliseconds between two frames of the fade"
    default 25
    range 5 500

config SHARED_KEY_RGB_RAIL_OFF_MS
    int "Milliseconds after the last fade before the LED power rail goes off again"
    default 2000
    range 100 60000
    help
      Only on a half where ZMK_RGB_UNDERGLOW_EXT_POWER is on, where the rail
      is off whenever the underglow is off.

endif # SHARED_KEY_RGB
```

## boards/shields/kyria_oled/Kconfig.defconfig
```kconfig
# SPDX-License-Identifier: MIT
#
# Kyria OLED status screen for a 128x64 SSD1306: both batteries, the output with
# the Bluetooth profiles, the layer, the keys being pressed, and a clock that
# takes over after a while without key presses. The display node itself comes
# from the keyboard shield.

if SHIELD_KYRIA_OLED

choice ZMK_DISPLAY_WORK_QUEUE
    default ZMK_DISPLAY_WORK_QUEUE_DEDICATED
endchoice

choice ZMK_DISPLAY_STATUS_SCREEN
    default ZMK_DISPLAY_STATUS_SCREEN_CUSTOM
endchoice

config ZMK_DISPLAY_STATUS_SCREEN_CUSTOM
    imply KYRIA_OLED_WIDGET_STATUS

config KYRIA_OLED_WIDGET_STATUS
    bool "Kyria OLED status screen"
    select BESIM_DRAW
    select BESIM_KEYS_CORE
    select BESIM_STATUS_STATE if !ZMK_SPLIT || ZMK_SPLIT_ROLE_CENTRAL

config KYRIA_OLED_CLOCK
    bool "Show a clock after a period without key presses"
    default y
    depends on KYRIA_OLED_WIDGET_STATUS
    select BESIM_CLOCK

if KYRIA_OLED_CLOCK

config KYRIA_OLED_CLOCK_IDLE_SECONDS
    int "Seconds without a key press before the clock appears"
    default 300
    range 1 86400
    help
      The clock cannot appear before ZMK reports the keyboard as idle, which
      takes ZMK_IDLE_TIMEOUT. A smaller value here shows the clock at that
      moment.

config KYRIA_OLED_CLOCK_CONTRAST
    int "Display contrast while the idle clock is shown"
    default 16
    range 0 255
    help
      The panel is dimmed while it shows the idle clock and returns to
      SSD1306_DEFAULT_CONTRAST afterwards.

config KYRIA_OLED_CLOCK_PEEK_SECONDS
    int "Seconds the clock stays visible after a clock key"
    default 10
    range 1 3600

endif # KYRIA_OLED_CLOCK

if ZMK_SPLIT_ROLE_CENTRAL

config ZMK_SPLIT_BLE_CENTRAL_BATTERY_LEVEL_FETCHING
    default y

endif # ZMK_SPLIT_ROLE_CENTRAL

endif # SHIELD_KYRIA_OLED
```

## boards/shields/kyria_oled/Kconfig.shield
```kconfig
# SPDX-License-Identifier: MIT

config SHIELD_KYRIA_OLED
    def_bool $(shields_list_contains,kyria_oled)
```

## boards/shields/nice_view_besim/Kconfig.shield
```kconfig
# SPDX-License-Identifier: MIT

config SHIELD_NICE_VIEW_BESIM
    def_bool $(shields_list_contains,nice_view_besim)
```

## boards/shields/oled_besim/Kconfig.defconfig
```kconfig
# SPDX-License-Identifier: MIT
#
# besim OLED status screen for a 128x64 SSD1306: both batteries, the output with
# the Bluetooth profiles, the layer, the keys being pressed, and a clock that
# takes over after a while without key presses. The display node itself comes
# from the keyboard shield.

if SHIELD_OLED_BESIM

choice ZMK_DISPLAY_WORK_QUEUE
    default ZMK_DISPLAY_WORK_QUEUE_DEDICATED
endchoice

choice ZMK_DISPLAY_STATUS_SCREEN
    default ZMK_DISPLAY_STATUS_SCREEN_CUSTOM
endchoice

config ZMK_DISPLAY_STATUS_SCREEN_CUSTOM
    imply OLED_BESIM_WIDGET_STATUS

config OLED_BESIM_WIDGET_STATUS
    bool "besim OLED status screen"
    select BESIM_DRAW
    select BESIM_KEYS_CORE
    select BESIM_STATUS_STATE if !ZMK_SPLIT || ZMK_SPLIT_ROLE_CENTRAL

config OLED_BESIM_CLOCK
    bool "Show a clock after a period without key presses"
    default y
    depends on OLED_BESIM_WIDGET_STATUS
    select BESIM_CLOCK

if OLED_BESIM_CLOCK

config OLED_BESIM_CLOCK_IDLE_SECONDS
    int "Seconds without a key press before the clock appears"
    default 300
    range 1 86400
    help
      The clock cannot appear before ZMK reports the keyboard as idle, which
      takes ZMK_IDLE_TIMEOUT. A smaller value here shows the clock at that
      moment.

config OLED_BESIM_CLOCK_CONTRAST
    int "Display contrast while the idle clock is shown"
    default 16
    range 0 255
    help
      The panel is dimmed while it shows the idle clock and returns to
      SSD1306_DEFAULT_CONTRAST afterwards.

config OLED_BESIM_CLOCK_PEEK_SECONDS
    int "Seconds the clock stays visible after a clock key"
    default 10
    range 1 3600

endif # OLED_BESIM_CLOCK

if ZMK_SPLIT_ROLE_CENTRAL

config ZMK_SPLIT_BLE_CENTRAL_BATTERY_LEVEL_FETCHING
    default y

endif # ZMK_SPLIT_ROLE_CENTRAL

endif # SHIELD_OLED_BESIM
```

## boards/shields/oled_besim/Kconfig.shield
```kconfig
# SPDX-License-Identifier: MIT

config SHIELD_OLED_BESIM
    def_bool $(shields_list_contains,oled_besim)
```

## dts/bindings/behaviors/zmk,behavior-besim-clock.yaml
```yaml
# SPDX-License-Identifier: MIT

description: Clock control for the Kyria OLED status screen

compatible: "zmk,behavior-besim-clock"

include: one_param.yaml
```

## dts/bindings/behaviors/zmk,behavior-led-mode.yaml
```yaml
# SPDX-License-Identifier: MIT

description: Cycles the LED mode (off, underglow, per-key, both) on both halves

compatible: "zmk,behavior-led-mode"

include: zero_param.yaml
```

## dts/bindings/behaviors/zmk,behavior-oled-clock.yaml
```yaml
# SPDX-License-Identifier: MIT

description: Clock control for the Kyria OLED status screen

compatible: "zmk,behavior-oled-clock"

include: one_param.yaml
```

## dts/bindings/skuratovich,key-rgb.yaml
```yaml
# SPDX-License-Identifier: MIT

description: |
  Reactive per-key RGB: a pressed key lights its LED in a random colour and
  fades out. The node tells which LED of this half's strip (the chosen
  zmk,underglow node) belongs to each key position of the keymap.

compatible: "skuratovich,key-rgb"

properties:
  key-leds:
    type: array
    required: true
    description: |
      One entry per key position of the keymap, in keymap order: the index of
      the key's LED in the chain of the half that carries the key, or 255 for a
      key without an LED. Both halves read the same map and each half only looks
      up its own keys.
```

## dts/bindings/skuratovich,led-frame.yaml
```yaml
# SPDX-License-Identifier: MIT

description: |
  The LED frame of this half: the one writer of the physical LED chain. ZMK's
  underglow (through a skuratovich,led-strip-window) and the per-key effect
  write their pixels into it.

compatible: "skuratovich,led-frame"

properties:
  strip:
    type: phandle
    required: true
    description: The physical LED strip (the WS2812 chain).
```

## dts/bindings/skuratovich,led-strip-window.yaml
```yaml
# SPDX-License-Identifier: MIT

description: |
  A LED strip that is a window onto part of the LED frame. Point ZMK's chosen
  zmk,underglow at it to confine the underglow effects to some LEDs of the
  chain.

compatible: "skuratovich,led-strip-window"

include: base.yaml

properties:
  offset:
    type: int
    default: 0
    description: Index in the frame of the window's first LED.
  chain-length:
    type: int
    required: true
    description: Number of LEDs in the window.
```

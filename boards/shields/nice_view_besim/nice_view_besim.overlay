/*
 * SPDX-License-Identifier: MIT
 *
 * Identical to the stock ZMK nice_view overlay: the display itself is the same
 * Sharp LS0XX memory LCD, only the status screen drawn on it is custom.
 */

&nice_view_spi {
    status = "okay";
    nice_view: ls0xx@0 {
        compatible = "sharp,ls0xx";
        spi-max-frequency = <1000000>;
        reg = <0>;
        width = <160>;
        height = <68>;
        serial-vcom-inversion;
        serial-vcom-interval = <33>;
    };
};

/ {
    chosen {
        zephyr,display = &nice_view;
    };
};
